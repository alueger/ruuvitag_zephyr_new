## drivers/shtc3/zephyr/Kconfig
```kconfig
# SHTCX temperature and humidity sensor configuration options

# Copyright (c) 2021 Thomas Stranger
# SPDX-License-Identifier: Apache-2.0


menuconfig SHTC3
	bool "SHTC3 Temperature Sensors"
	depends on I2C
	help
	  Enable I2C driver for SHTC3 temperature sensor.
```
